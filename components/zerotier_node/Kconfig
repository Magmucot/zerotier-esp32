## main/Kconfig.projbuild
```kconfig
menu "ZeroTier ESP32 Application Configuration"

    config ESP_WIFI_SSID
        string "Wi-Fi SSID"
        default ""
        help
            SSID of the Wi-Fi network for ESP32 station mode to connect to.
            Can be left empty if unconfigured or provisioned at runtime.

    config ESP_WIFI_PASSWORD
        string "Wi-Fi Password"
        default ""
        help
            Wi-Fi password (WPA/WPA2/WPA3) for station mode.
            Can be left empty for open networks or if unconfigured.

    config ESP_MAXIMUM_RETRY
        int "Maximum Wi-Fi Connection Retries"
        default 10
        range 1 50
        help
            Maximum retry attempts for Wi-Fi connection before reporting failure.

    config ZT_NETWORK_ID
        string "ZeroTier Network ID (16-char hex, e.g. 0x...)"
        default ""
        help
            16-digit hexadecimal ZeroTier network ID (e.g. 0x0123456789abcdef).
            If left empty, the ZeroTier node will initialize without auto-joining a network.

    config PING_TARGET_IP
        string "Ping Target IP Address"
        default "1.1.1.1"
        help
            Target IPv4 address for background network latency measurement.

endmenu
```

## sdkconfig.defaults
```kconfig
CONFIG_IDF_TARGET="esp32s3"
CONFIG_ESP_DEFAULT_CPU_FREQ_MHZ_240=y
CONFIG_ESP_MAIN_TASK_STACK_SIZE=65536
CONFIG_ESP_TASK_WDT_TIMEOUT_S=60
CONFIG_FREERTOS_HZ=1000
CONFIG_LWIP_IPV6=y
CONFIG_PARTITION_TABLE_CUSTOM=y
CONFIG_PARTITION_TABLE_CUSTOM_FILENAME="partitions.csv"
CONFIG_PARTITION_TABLE_FILENAME="partitions.csv"
CONFIG_ESPTOOLPY_FLASHSIZE_16MB=y
CONFIG_ESPTOOLPY_FLASHSIZE="16MB"

# IRAM fix: move FreeRTOS code to Flash
CONFIG_FREERTOS_PLACE_FUNCTIONS_INTO_FLASH=y

# PSRAM activation
CONFIG_SPIRAM=y
CONFIG_SPIRAM_MODE_OCT=y
CONFIG_SPIRAM_USE_MALLOC=y
CONFIG_SPIRAM_MEMTEST=y
CONFIG_SPIRAM_SPEED_80M=y

# VFS is required for /dev/urandom (Utils::getSecureRandom)
CONFIG_VFS_SUPPORT_TERMIOS=y

CONFIG_SPIRAM_ALLOW_BSS_SEG_EXTERNAL_MEMORY=y
CONFIG_SPIRAM_FETCH_INSTRUCTIONS=y
CONFIG_SPIRAM_RODATA=y
```
